## capi_driver/Kconfig
```kconfig
#
# IBM Accelerator Family 'GenWQE'
#

menuconfig CGZIP
	tristate "GenWQE PCIe Accelerator"
	depends on PCI && 64BIT && CXL && CXL_KERNEL_API
	default n
	help
	  Enables PCIe card driver for IBM CAPI GZIP accelerators.
```
